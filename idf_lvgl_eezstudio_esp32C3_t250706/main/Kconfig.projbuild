## idf_lvgl_eezstudio_esp32C3_t250706/main/Kconfig.projbuild
```kconfig
menu "Example Configuration"

    choice EXAMPLE_LCD_CONTROLLER
        prompt "LCD控制器型号"
        default EXAMPLE_LCD_CONTROLLER_ST7789
        help
            选择LCD控制器型号

        config EXAMPLE_LCD_CONTROLLER_ILI9341
            bool "ILI9341"

        config EXAMPLE_LCD_CONTROLLER_GC9A01
            bool "GC9A01"
        
        config EXAMPLE_LCD_CONTROLLER_ST7789
            bool "ST7789"
    endchoice

    choice EXAMPLE_LCD_INPUT_TYPE
        prompt "LCD输入类型选择（触摸或键盘）"
        default EXAMPLE_LCD_TOUCH_ENABLED
        help
            选择LCD输入类型，只能选一种：触摸或键盘。

        config EXAMPLE_LCD_TOUCH_ENABLED
            bool "启用LCD触摸"
            help
                启用此选项以使用显示屏触摸，可选择触摸控制器。

        # Touch controller selection is only available when Touch is enabled
        choice EXAMPLE_LCD_TOUCH_CONTROLLER
            prompt "LCD触摸控制器型号"
            depends on EXAMPLE_LCD_TOUCH_ENABLED
            default EXAMPLE_LCD_TOUCH_CONTROLLER_FT6336
            help
                选择LCD触摸控制器型号

            config EXAMPLE_LCD_TOUCH_CONTROLLER_STMPE610
                bool "STMPE610"
            
            config EXAMPLE_LCD_TOUCH_CONTROLLER_FT6336
                bool "FT6336"
        endchoice

        config EXAMPLE_LCD_KEYBOARD_ENABLED
            bool "启用LCD键盘"
            help
                启用此选项以使用显示屏键盘。
    endchoice

endmenu
```

## idf_lvgl_eezstudio_esp32C3_t250706/sdkconfig.defaults
```kconfig
CONFIG_LV_USE_USER_DATA=y
CONFIG_LV_COLOR_16_SWAP=y
CONFIG_LV_COLOR_DEPTH_16=y

CONFIG_IDF_TARGET_ESP32=y
CONFIG_ESP_DEFAULT_CPU_FREQ_MHZ_240=y
CONFIG_ESPTOOLPY_FLASHSIZE_4MB=y
```

## idf_t250702_oled_menu_design_from0to1/sdkconfig.defaults
```kconfig
# ESP32默认配置
# CPU主频配置为240MHz
CONFIG_ESP32_DEFAULT_CPU_FREQ_240=y
CONFIG_ESP32_DEFAULT_CPU_FREQ_MHZ=240

# 目标芯片配置为ESP32
CONFIG_IDF_TARGET_ESP32=y
CONFIG_IDF_TARGET="esp32"

# Flash配置为4MB
CONFIG_ESPTOOLPY_FLASHSIZE_4MB=y
CONFIG_ESPTOOLPY_FLASHSIZE="4MB"

# Flash频率配置为40MHz
CONFIG_ESPTOOLPY_FLASHFREQ_40M=y
CONFIG_ESPTOOLPY_FLASHFREQ="40m"
```
