// /* fastOLED example
//         OLED Display 0.96" (SSD1315 0.96 / SSD1306 0.96)
//  */

// #include <stdio.h>
// #include "esp_log.h"
// #include "esp_err.h"
// #include "driver/i2c.h"
// #include "aniBuf.h"

// #include "freertos/FreeRTOS.h"
// #include "freertos/task.h"

// static const char *TAG = "fastOLED";

// #define I2C_MASTER_FREQ_HZ 1000000 /*!< I2C master clock frequency */ /*!< I2C master doesn't need buffer */
// #define I2C_MASTER_TIMEOUT_MS 50

// #define I2C_ADDRESS 0x78

// #define HEIGHT 64
// #define WIDTH 128

// uint8_t buffer[((WIDTH * HEIGHT) / 8)];
// i2c_cmd_handle_t fullHandle = NULL;

// esp_err_t setupI2c(void)
// {
//     i2c_config_t conf = {
//         .mode = I2C_MODE_MASTER,
//         .sda_io_num = 21,
//         .scl_io_num = 22,
//         .sda_pullup_en = GPIO_PULLUP_ENABLE,
//         .scl_pullup_en = GPIO_PULLUP_ENABLE,
//         .master.clk_speed = I2C_MASTER_FREQ_HZ};

//     i2c_param_config(0, &conf);

//     return i2c_driver_install(0, conf.mode, 0, 0, 0);
// }

// /**
//  * 清屏函数 - 将整个SSD1106显存设置为0
//  */
// esp_err_t ssd1106_clear_display(void)
// {
//     esp_err_t ret;
//     i2c_cmd_handle_t cmd_handle;

//     // 为每个Page发送清空命令
//     for (uint8_t page = 0; page < 8; page++)
//     {
//         // 设置当前Page地址 (0xB0-0xB7)
//         cmd_handle = i2c_cmd_link_create();
//         i2c_master_start(cmd_handle);
//         ESP_ERROR_CHECK(i2c_master_write_byte(fullHandle, I2C_ADDRESS, true));
//         ESP_ERROR_CHECK(i2c_master_write_byte(fullHandle, 0x0, true)); // 控制字节
//         i2c_master_write_byte(cmd_handle, 0xB0 | page, true);          // 设置Page地址

//         // 设置列地址范围 (0-127)
//         ESP_ERROR_CHECK(i2c_master_write_byte(fullHandle, 0x0, true)); // 控制字节
//         i2c_master_write_byte(cmd_handle, 0x00, true);                 // 低4位列地址
//         ESP_ERROR_CHECK(i2c_master_write_byte(fullHandle, 0x0, true)); // 控制字节
//         i2c_master_write_byte(cmd_handle, 0x10, true);                 // 高4位列地址

//         // 发送128字节的0数据
//         ESP_ERROR_CHECK(i2c_master_write_byte(fullHandle, 0x0, true)); // 控制字节
//         for (int i = 0; i < 128; i++)
//         {
//             i2c_master_write_byte(cmd_handle, 0x00, true);
//         }

//         i2c_master_stop(cmd_handle);
//         ret = i2c_master_cmd_begin(I2C_NUM_0, cmd_handle, 1000 / portTICK_PERIOD_MS);
//         i2c_cmd_link_delete(cmd_handle);

//         if (ret != ESP_OK)
//         {
//             ESP_LOGE(TAG, "清屏时Page %d写入失败", page);
//             return ret;
//         }
//     }

//     return ESP_OK;
// }

// esp_err_t beginScreen(void)
// {
//     fullHandle = i2c_cmd_link_create();
//     if (fullHandle == NULL)
//     {
//         ESP_LOGI(TAG, "Not enough memory");
//         while (true)
//         {
//             ESP_LOGI(TAG, ".");
//         }
//     }

//     // 初始化 I2C 通信
//     ESP_ERROR_CHECK(i2c_master_start(fullHandle));
//     ESP_ERROR_CHECK(i2c_master_write_byte(fullHandle, I2C_ADDRESS, true));
//     ESP_ERROR_CHECK(i2c_master_write_byte(fullHandle, 0x0, true)); // 控制字节

//     // 显示基本设置
//     ESP_ERROR_CHECK(i2c_master_write_byte(fullHandle, 0xAE, true)); // 进入睡眠模式
//     ESP_ERROR_CHECK(i2c_master_write_byte(fullHandle, 0xD5, true)); // 设置刷新率和分频器
//     ESP_ERROR_CHECK(i2c_master_write_byte(fullHandle, 0xF0, true)); // 分频值

//     // 显示尺寸设置
//     ESP_ERROR_CHECK(i2c_master_write_byte(fullHandle, 0xA8, true)); // 设置列复用率
//     ESP_ERROR_CHECK(i2c_master_write_byte(fullHandle, 0x3F, true)); // 复用率值
//     ESP_ERROR_CHECK(i2c_master_write_byte(fullHandle, 0xD3, true)); // 设置显示偏移
//     ESP_ERROR_CHECK(i2c_master_write_byte(fullHandle, 0x0, true));  // 偏移值
//     ESP_ERROR_CHECK(i2c_master_write_byte(fullHandle, 0x40, true)); // 设置显示起始行

//     // 电源设置
//     ESP_ERROR_CHECK(i2c_master_write_byte(fullHandle, 0x8D, true)); // 充电泵设置
//     ESP_ERROR_CHECK(i2c_master_write_byte(fullHandle, 0x14, true)); // 启用充电泵

//     // 内存寻址模式设置
//     ESP_ERROR_CHECK(i2c_master_write_byte(fullHandle, 0x20, true)); // 设置内存寻址模式
//     ESP_ERROR_CHECK(i2c_master_write_byte(fullHandle, 0x00, true)); // 水平寻址模式

//     // 列和页地址设置
//     ESP_ERROR_CHECK(i2c_master_write_byte(fullHandle, 0x21, true)); // 设置列地址寄存器
//     ESP_ERROR_CHECK(i2c_master_write_byte(fullHandle, 0x0, true));  // 设置起始列为0
//     ESP_ERROR_CHECK(i2c_master_write_byte(fullHandle, 0x7F, true)); // 设置结束列为127

//     ESP_ERROR_CHECK(i2c_master_write_byte(fullHandle, 0x22, true)); // 设置页地址寄存器
//     ESP_ERROR_CHECK(i2c_master_write_byte(fullHandle, 0x0, true));  // 设置起始页为0
//     ESP_ERROR_CHECK(i2c_master_write_byte(fullHandle, 0x7, true));  // 设置结束页为7

//     // 显示方向设置
//     ESP_ERROR_CHECK(i2c_master_write_byte(fullHandle, 0xA1, true)); // 启用内存重映射
//     ESP_ERROR_CHECK(i2c_master_write_byte(fullHandle, 0xC8, true)); // 设置COM输出扫描方向

//     // COM引脚配置
//     ESP_ERROR_CHECK(i2c_master_write_byte(fullHandle, 0xDA, true)); // 设置COM引脚配置
//     ESP_ERROR_CHECK(i2c_master_write_byte(fullHandle, 0x12, true)); // 硬件COM引脚配置

//     // 对比度设置
//     ESP_ERROR_CHECK(i2c_master_write_byte(fullHandle, 0x81, true)); // 设置对比度(亮度)
//     // ESP_ERROR_CHECK(i2c_master_write_byte(fullHandle, 0xFF, true)); // 对比度值255
//     //  ESP_ERROR_CHECK(i2c_master_write_byte(fullHandle, 0x01, true)); //1
//     ESP_ERROR_CHECK(i2c_master_write_byte(fullHandle, 0x7F, true)); // 127

//     // 预充电和VCOM设置
//     ESP_ERROR_CHECK(i2c_master_write_byte(fullHandle, 0xD9, true)); // 设置预充电
//     ESP_ERROR_CHECK(i2c_master_write_byte(fullHandle, 0x22, true)); // 设置预充电值
//     ESP_ERROR_CHECK(i2c_master_write_byte(fullHandle, 0xDB, true)); // 设置VCOM
//     ESP_ERROR_CHECK(i2c_master_write_byte(fullHandle, 0x20, true)); // VCOM值0.77v

//     // 显示内容设置
//     ESP_ERROR_CHECK(i2c_master_write_byte(fullHandle, 0xA4, true)); // 显示GDDRAM内容
//     ESP_ERROR_CHECK(i2c_master_write_byte(fullHandle, 0xA6, true)); // 设置正常显示模式
//     ESP_ERROR_CHECK(i2c_master_write_byte(fullHandle, 0x2E, true)); // 停用滚动

//     // 开启显示
//     ESP_ERROR_CHECK(i2c_master_write_byte(fullHandle, 0xAF, true)); // 开启显示

//     // 结束I2C通信
//     ESP_ERROR_CHECK(i2c_master_stop(fullHandle));
//     ESP_ERROR_CHECK(i2c_master_cmd_begin(I2C_NUM_0, fullHandle, pdMS_TO_TICKS(I2C_MASTER_TIMEOUT_MS)));
//     i2c_cmd_link_delete(fullHandle);

//     return ESP_OK;
// }

// void drawPixel(int x, int y, int colour)
// {
//     int byteLocation = ((y / 8) * WIDTH) + x;
//     uint8_t newByte = buffer[byteLocation];
//     if (colour)
//     {
//         newByte |= 1 << (y % 8);
//     }
//     else
//     {
//         newByte &= ~(1 << (y % 8));
//     }

//     buffer[byteLocation] = newByte;
// }

// void bufToScreen(void)
// {
//     fullHandle = i2c_cmd_link_create();
//     if (fullHandle == NULL)
//     {
//         ESP_LOGI(TAG, "Not enough memory");
//         while (true)
//         {
//             ESP_LOGI(TAG, ".");
//         }
//     }
//     ESP_ERROR_CHECK(i2c_master_start(fullHandle));
//     ESP_ERROR_CHECK(i2c_master_write_byte(fullHandle, I2C_ADDRESS, false));
//     ESP_ERROR_CHECK(i2c_master_write_byte(fullHandle, 0x40, false)); // control byte
//     ESP_ERROR_CHECK(i2c_master_write(fullHandle, buffer, 1024, false));
//     ESP_ERROR_CHECK(i2c_master_stop(fullHandle));
//     ESP_ERROR_CHECK(i2c_master_cmd_begin(I2C_NUM_0, fullHandle, pdMS_TO_TICKS(I2C_MASTER_TIMEOUT_MS)));
//     i2c_cmd_link_delete(fullHandle);
// }

// void directToScreenAnimation(const unsigned char myAnimationBuf[][1024], int frames)
// {
//     for (int i = 0; i < frames; i++) // change with the number of frames
//     {
//         fullHandle = i2c_cmd_link_create();
//         if (fullHandle == NULL)
//         {
//             ESP_LOGI(TAG, "Not enough memory");
//             while (true)
//             {
//                 ESP_LOGI(TAG, ".");
//             }
//         }
//         ESP_ERROR_CHECK(i2c_master_start(fullHandle));
//         ESP_ERROR_CHECK(i2c_master_write_byte(fullHandle, I2C_ADDRESS, false));
//         ESP_ERROR_CHECK(i2c_master_write_byte(fullHandle, 0x40, false)); // control byte
//         ESP_ERROR_CHECK(i2c_master_write(fullHandle, myAnimationBuf[i], 1024, false));
//         ESP_ERROR_CHECK(i2c_master_stop(fullHandle));
//         ESP_ERROR_CHECK(i2c_master_cmd_begin(I2C_NUM_0, fullHandle, pdMS_TO_TICKS(I2C_MASTER_TIMEOUT_MS)));
//         i2c_cmd_link_delete(fullHandle);
//     }
// }

// void app_main(void)
// {
//     ESP_ERROR_CHECK(setupI2c()); // just the I2C config. No screen business
//     ESP_LOGI(TAG, "Initialized successfully");
//     ESP_ERROR_CHECK(beginScreen()); // basic screen config. No need to touch

//     while (true)
//     {
//         for (int i = 0; i < 1024; i++)
//         {
//             buffer[i] = 0;
//         }

//         // for (int i = 0; i < 64; i++)
//         // {
//         //     drawPixel(0, i, 1);
//         //     bufToScreen();
//         // }

//         // for (int i = 0; i < 128; i++)
//         // {
//         //     drawPixel(i, 63, 1);
//         //     bufToScreen();
//         // }

//         // for (int i = 63; i >= 0; i--)
//         // {
//         //     drawPixel(127, i, 1);
//         //     bufToScreen();
//         // }

//         // for (int i = 127; i >= 0; i--)
//         // {
//         //     drawPixel(i, 0, 1);
//         //     bufToScreen();
//         // }

//         // for (int i = 0; i < 5; i++)
//         // {
//         //     directToScreenAnimation(fingerWalkAnimation, 37);
//         // }
//         // for (int i = 0; i < 5; i++)
//         // {
//         //     directToScreenAnimation(fingerPrintAnimation, 37);
//         // }
//         // for (int i = 0; i < 5; i++)
//         // {
//         //     directToScreenAnimation(churchAnimation, 161);
//         // }
//         // for (int i = 0; i < 5; i++)
//         // {
//         //     directToScreenAnimation(pendriveAnimation, 103);
//         // }
//         //  for (int i = 0; i < 5; i++)
//         // {
//         //     directToScreenAnimation(fingerPrintAnimation, 60);
//         // }

//         for (int i = 0; i < 5; i++)
//         {
//             directToScreenAnimation(bufferAnimation, 43);
//         }
//     }
// }

void directToScreenAnimation(const unsigned char myAnimationBuf[][1024], int frames);
#include "aniBuf.h"


void showGIF(uint8_t column, uint8_t page, uint8_t w, uint8_t h, uint8_t pic_data[], uint8_t pic_frame, int color);

//////////////////////////////////////////////////////////////////
/*
                          ESP-IDF 硬件I2C
                          ------------OLED SSH1106/SSD1306
 */

#include <stdio.h>
#include <stdint.h>
#include "esp_log.h"
#include "driver/i2c.h"

#include "freertos/FreeRTOS.h"

#include "freertos/task.h"

static const char *TAG = "i2c-simple-example";

#define I2C_MASTER_SCL_IO 22        /*!< GPIO number used for I2C master clock */
#define I2C_MASTER_SDA_IO 21        /*!< GPIO number used for I2C master data  */
#define I2C_MASTER_NUM 0            /*!< I2C master i2c port number, the number of i2c peripheral interfaces available will depend on the chip */
#define I2C_MASTER_FREQ_HZ 100000   /*!< I2C master clock frequency */
#define I2C_MASTER_TX_BUF_DISABLE 0 /*!< I2C master doesn't need buffer */
#define I2C_MASTER_RX_BUF_DISABLE 0 /*!< I2C master doesn't need buffer */
#define I2C_MASTER_TIMEOUT_MS 100

// 0x78 ＝ 0111 1000。最后一位是读写控制位，前面7个数，0111 100才是地址 也就是0011 1100，即0x3c
#define OLED_ADDR 0x3C // OLED的IIC地址，逻辑分析仪读出的  0x3c默认表示写

#define OLED_CMD 0
#define OLED_DATA 1

// OLED 6*8字库
unsigned char F6x8[][6] = {
    {0x00, 0x00, 0x00, 0x00, 0x00, 0x00}, // sp
    {0x00, 0x00, 0x00, 0x2f, 0x00, 0x00}, // !
    {0x00, 0x00, 0x07, 0x00, 0x07, 0x00}, // "
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    {0x14, 0x14, 0x14, 0x14, 0x14, 0x14}, // horiz lines
};

// OLED 8*16字库
unsigned char F8X16[] = {
    0x00, 0x00, 0x00, 0x00, 0x00, 0x00, 0x00, 0x00, 0x00, 0x00, 0x00, 0x00, 0x00, 0x00, 0x00, 0x00, // 0
    0x00, 0x00, 0x00, 0xF8, 0x00, 0x00, 0x00, 0x00, 0x00, 0x00, 0x00, 0x33, 0x30, 0x00, 0x00, 0x00, //! 1
    0x00, 0x10, 0x0C, 0x06, 0x10, 0x0C, 0x06, 0x00, 0x00, 0x00, 0x00, 0x00, 0x00, 0x00, 0x00, 0x00, //" 2
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    0x00, 0x06, 0x01, 0x01, 0x02, 0x02, 0x04, 0x04, 0x00, 0x00, 0x00, 0x00, 0x00, 0x00, 0x00, 0x00, //~ 94
};

// OLED 中文字库
unsigned char Hzk[][32] = {
    {0xE0, 0x00, 0xFF, 0x10, 0xE4, 0x24, 0xFF, 0x24, 0xE4, 0x10, 0xE8, 0x27, 0xB4, 0x2C, 0xE0, 0x00},
    {0x01, 0x00, 0xFF, 0x10, 0x09, 0x05, 0xFF, 0x05, 0x19, 0x80, 0x4F, 0x20, 0x1F, 0x20, 0xCF, 0x00}, /*"懒",0*/

    {0x00, 0x08, 0x88, 0x88, 0x89, 0x8E, 0x88, 0xF8, 0x88, 0x8C, 0x8B, 0x88, 0x88, 0x08, 0x00, 0x00},
    {0x08, 0x08, 0x08, 0x08, 0x08, 0x08, 0x08, 0xFF, 0x08, 0x08, 0x08, 0x08, 0x08, 0x08, 0x08, 0x00}, /*"羊",1*/

    {0x00, 0x08, 0x88, 0x88, 0x89, 0x8E, 0x88, 0xF8, 0x88, 0x8C, 0x8B, 0x88, 0x88, 0x08, 0x00, 0x00},
    {0x08, 0x08, 0x08, 0x08, 0x08, 0x08, 0x08, 0xFF, 0x08, 0x08, 0x08, 0x08, 0x08, 0x08, 0x08, 0x00} /*"羊",2*/
};

// 函数声明
static esp_err_t i2c_master_init(void);
static esp_err_t OLED_WR_Byte(uint8_t data, uint8_t cmd_);
void OLED_Init(void);
void OLED_Set_Pos(uint8_t x, uint8_t y);
void OLED_ShowChar(uint8_t x, uint8_t y, uint8_t chr, uint8_t Char_Size);
void OLED_Clear(void);
void OLED_ShowNum(uint8_t x, uint8_t y, uint32_t num, uint8_t len, uint8_t size2);
uint32_t oled_pow(uint8_t m, uint8_t n);
void OLED_ShowString(uint8_t x, uint8_t y, char *chr, uint8_t Char_Size);
void OLED_ShowCHinese(uint8_t x, uint8_t y, uint8_t no);

/**
 * @description: 主函数
 * @return       无
 */
void app_main(void)
{
    // IIC总线主机初始化
    ESP_ERROR_CHECK(i2c_master_init());
    ESP_LOGI(TAG, "I2C initialized successfully");

    // OLED屏幕初始化
    OLED_Init();

    // // 显示汉字
    // OLED_ShowCHinese(0 * 18, 0, 0);
    // OLED_ShowCHinese(1 * 18, 0, 1);
    // OLED_ShowCHinese(2 * 18, 0, 2);

    // // 显示单个字符
    // OLED_ShowChar(0, 2, 'Q', 16);

    // // 显示字符串
    // OLED_ShowString(0, 4, "Fairy tale", 16);

    // // 显示数字
    // OLED_ShowNum(0, 6, 8266, 6, 16);

    // 删除IIC设备
    // ESP_ERROR_CHECK(i2c_driver_delete(I2C_MASTER_NUM));
    // ESP_LOGI(TAG, "I2C unitialized successfully");

    while (1)
    {
        /* code */
        OLED_Clear();
        for (int i = 0; i < 100; i++)
        {
            showGIF(0 ,0, 64 ,64, gImage_test, i, 1);
            // vTaskDelay(pdMS_TO_TICKS(1));
        }
    }
}

////////////////////////////////////////////////////////////////////////////////////////////////////
/**
 * @brief i2c master initialization
 */
static esp_err_t i2c_master_init(void)
{
    int i2c_master_port = I2C_MASTER_NUM;

    i2c_config_t conf = {
        .mode = I2C_MODE_MASTER,
        .sda_io_num = I2C_MASTER_SDA_IO, // 18
        .scl_io_num = I2C_MASTER_SCL_IO, // 19
        .sda_pullup_en = GPIO_PULLUP_ENABLE,
        .scl_pullup_en = GPIO_PULLUP_ENABLE,
        .master.clk_speed = I2C_MASTER_FREQ_HZ,
    };

    i2c_param_config(i2c_master_port, &conf);

    return i2c_driver_install(i2c_master_port, conf.mode, I2C_MASTER_RX_BUF_DISABLE, I2C_MASTER_TX_BUF_DISABLE, 0);
}

/**
 * @description: OLED 发送一个字节
 * @return       错误信息
 * @param {uint8_t} data 需要发送的内容，数据或者命令
 * @param {uint8_t} cmd_ 1:发送数据 0:发送命令
 */
static esp_err_t OLED_WR_Byte(uint8_t data, uint8_t cmd_)
{
    int ret;

    uint8_t write_buf[2] = {((cmd_ == 1) ? (0x40) : (0x00)), data};

    ret = i2c_master_write_to_device(I2C_MASTER_NUM, OLED_ADDR, write_buf, sizeof(write_buf), pdMS_TO_TICKS(I2C_MASTER_TIMEOUT_MS));

    return ret;
}

/**
 * @description: OLED 屏幕初始化
 * @return       无
 */
void OLED_Init(void)
{
    OLED_WR_Byte(0xAE, OLED_CMD); //--display off
    OLED_WR_Byte(0x00, OLED_CMD); //---set low column address
    OLED_WR_Byte(0x10, OLED_CMD); //---set high column address
    OLED_WR_Byte(0x40, OLED_CMD); //--set start line address
    OLED_WR_Byte(0xB0, OLED_CMD); //--set page address
    OLED_WR_Byte(0x81, OLED_CMD); // contract control
    OLED_WR_Byte(0xFF, OLED_CMD); //--128
    OLED_WR_Byte(0xA1, OLED_CMD); // set segment remap
    OLED_WR_Byte(0xA6, OLED_CMD); //--normal / reverse
    OLED_WR_Byte(0xA8, OLED_CMD); //--set multiplex ratio(1 to 64)
    OLED_WR_Byte(0x3F, OLED_CMD); //--1/32 duty
    OLED_WR_Byte(0xC8, OLED_CMD); // Com scan direction
    OLED_WR_Byte(0xD3, OLED_CMD); //-set display offset
    OLED_WR_Byte(0x00, OLED_CMD); //
    OLED_WR_Byte(0xD5, OLED_CMD); // set osc division
    OLED_WR_Byte(0x80, OLED_CMD); //
    OLED_WR_Byte(0xD8, OLED_CMD); // set area color mode off
    OLED_WR_Byte(0x05, OLED_CMD); //
    OLED_WR_Byte(0xD9, OLED_CMD); // Set Pre-Charge Period
    OLED_WR_Byte(0xF1, OLED_CMD); //
    OLED_WR_Byte(0xDA, OLED_CMD); // set com pin configuartion
    OLED_WR_Byte(0x12, OLED_CMD); //
    OLED_WR_Byte(0xDB, OLED_CMD); // set Vcomh
    OLED_WR_Byte(0x30, OLED_CMD); //
    OLED_WR_Byte(0x8D, OLED_CMD); // set charge pump enable
    OLED_WR_Byte(0x14, OLED_CMD); //
    OLED_WR_Byte(0xAF, OLED_CMD); //--turn on oled panel
    OLED_Clear();
}

/**
 * @description: OLED 屏幕 设置坐标
 * @return       无
 * @param {uint8_t} x 坐标x轴，范围0~127
 * @param {uint8_t} y 坐标y轴，范围0~63
 */
void OLED_Set_Pos(uint8_t x, uint8_t y)
{
    OLED_WR_Byte(0xb0 + y, OLED_CMD);
    OLED_WR_Byte(((x & 0xf0) >> 4) | 0x10, OLED_CMD);
    OLED_WR_Byte((x & 0x0f), OLED_CMD);
}

/**
 * @description: OLED 清屏
 * @return       无
 */
void OLED_Clear(void)
{
    uint8_t i, n;
    for (i = 0; i < 8; i++)
    {
        OLED_WR_Byte(0xb0 + i, OLED_CMD);
        OLED_WR_Byte(0x00, OLED_CMD);
        OLED_WR_Byte(0x10, OLED_CMD);
        for (n = 0; n < 128; n++)
            OLED_WR_Byte(0, OLED_DATA);
    }
}

/**
 * @description: OLED 显示单个字符
 * @return       无
 * @param {uint8_t} x 显示字符的x坐标，范围0~127
 * @param {uint8_t} y 显示字符的y坐标，字符大小为16，取值0,2,4,6；字符大小6，取值0,1,2,3,4,5,6,7
 * @param {uint8_t} chr 显示的单个字符，在字库中出现的字符
 * @param {uint8_t} Char_Size 字符大小，取16或者8
 */
void OLED_ShowChar(uint8_t x, uint8_t y, uint8_t chr, uint8_t Char_Size)
{
    uint8_t c = 0;
    uint8_t i = 0;
    c = chr - ' ';
    if (x > 127)
    {
        x = 0;
        y = y + 2;
    }
    if (Char_Size == 16)
    {
        OLED_Set_Pos(x, y);
        for (i = 0; i < 8; i++)
            OLED_WR_Byte(F8X16[c * 16 + i], OLED_DATA);
        OLED_Set_Pos(x, y + 1);
        for (i = 0; i < 8; i++)
            OLED_WR_Byte(F8X16[c * 16 + i + 8], OLED_DATA);
    }
    else
    {
        OLED_Set_Pos(x, y);
        for (i = 0; i < 6; i++)
            OLED_WR_Byte(F6x8[c][i], OLED_DATA);
    }
}

/**
 * @description: OLED 显示字符串，会自动换行
 * @return       无
 * @param {uint8_t} x 显示字符串第一个字符的x坐标，范围0~127
 * @param {uint8_t} y 显示字符串第一个字符的y坐标，字符大小为16，取值0,2,4,6；字符大小6，取值0,1,2,3,4,5,6,7
 * @param {char} *chr 显示的字符串
 * @param {uint8_t} Char_Size 字符大小，取16或者8
 */
void OLED_ShowString(uint8_t x, uint8_t y, char *chr, uint8_t Char_Size)
{
    unsigned char j = 0;
    while (chr[j] != '\0')
    {
        OLED_ShowChar(x, y, chr[j], Char_Size);
        x += 8;
        if (x > 120)
        {
            x = 0;
            y += 2;
        }
        j++;
    }
}

/**
 * @description: OLED 显示汉字
 * @return       无
 * @param {uint8_t} x 显示汉字的x坐标
 * @param {uint8_t} y 显示汉字的y坐标
 * @param {uint8_t} no 显示汉字在字库中的序号
 */
void OLED_ShowCHinese(uint8_t x, uint8_t y, uint8_t no)
{
    uint8_t t, adder = 0;
    OLED_Set_Pos(x, y);
    for (t = 0; t < 16; t++)
    {
        OLED_WR_Byte(Hzk[2 * no][t], OLED_DATA);
        adder += 1;
    }
    OLED_Set_Pos(x, y + 1);
    for (t = 0; t < 16; t++)
    {
        OLED_WR_Byte(Hzk[2 * no + 1][t], OLED_DATA);
        adder += 1;
    }
}

/**
 * @description: 求m^n的函数
 * @return       m^n的结果
 * @param {uint8_t} m 底数
 * @param {uint8_t} n 指数
 */
uint32_t oled_pow(uint8_t m, uint8_t n)
{
    uint32_t result = 1;
    while (n--)
        result *= m;
    return result;
}

/**
 * @description: OLED 显示数字
 * @return       无
 * @param {uint8_t} x 显示数字的第一个位置的x坐标
 * @param {uint8_t} y 显示数字的第一个位置的y坐标
 * @param {uint32_t} num 欲显示的数字
 * @param {uint8_t} len 显示所占的长度，不建议小于真正要显示的数字的长度
 * @param {uint8_t} size2 显示的数字的大小，16、8可选
 */
void OLED_ShowNum(uint8_t x, uint8_t y, uint32_t num, uint8_t len, uint8_t size2)
{
    uint8_t t, temp;
    uint8_t enshow = 0;
    for (t = 0; t < len; t++)
    {
        temp = (num / oled_pow(10, len - t - 1)) % 10;
        if (enshow == 0 && t < (len - 1))
        {
            if (temp == 0)
            {
                OLED_ShowChar(x + (size2 / 2) * t, y, ' ', size2);
                continue;
            }
            else
                enshow = 1;
        }
        OLED_ShowChar(x + (size2 / 2) * t, y, temp + '0', size2);
    }
}

/**
 *              绘制GIF
 */

i2c_cmd_handle_t fullHandle = NULL;

void directToScreenAnimation(const unsigned char myAnimationBuf[][1024], int frames)
{
}

void showGIF(uint8_t column, uint8_t page, uint8_t w, uint8_t h, uint8_t pic_data[], uint8_t pic_frame, int color)
{

    uint8_t pages = h / 8 + ((h % 8) ? 1 : 0);
    uint32_t f = w * pages * pic_frame;

    for (uint8_t j = 0; j < pages; j++)
    {
        /* code */
        if (page + j > 7)
            return;

        OLED_Set_Pos(column, page + j);

        for (uint8_t i = 0; i < w; i++)
        {
            /* code */
            if (column + i > 127)
                break;
            if (color == 1)
                OLED_WR_Byte(pic_data[f + i + w * j], OLED_DATA);
            else if (color == 0)
                OLED_WR_Byte(~pic_data[f + i + w * j], OLED_DATA);
        }
    }
}